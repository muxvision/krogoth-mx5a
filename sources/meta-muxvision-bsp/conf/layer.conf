## sources/meta-muxvision-bsp/conf/layer.conf
```bitbake
# We have a conf and classes directory, add to BBPATH
BBPATH .= ":${LAYERDIR}"

# We have a packages directory, add to BBFILES
BBFILES += "${LAYERDIR}/recipes-*/*/*.bb \
            ${LAYERDIR}/recipes-*/*/*.bbappend"

BBFILE_COLLECTIONS += "muxvision-bsp"
BBFILE_PATTERN_muxvision-bsp := "^${LAYERDIR}/"
BBFILE_PRIORITY_muxvision-bsp = "4"
```
